// Generated by scripts/embed_web.py. Edit assets/web/ instead.
static const char webHead[] = R"WEB(<!doctype html><html lang="en"><head><meta name="viewport" content="width=device-width,initial-scale=1"><title>Nostr Pager</title><style>
:root{color-scheme:dark}*{box-sizing:border-box}body{background:radial-gradient(ellipse at top right,#19372f55,transparent 55%),#0c111b;color:#eaf0fa;font:16px system-ui;margin:0;padding:24px 18px 40px}main{max-width:680px;margin:auto}.brand{display:flex;align-items:center;gap:14px;margin-bottom:26px}.brand svg{width:48px;height:48px}.wordmark{font-weight:750;letter-spacing:.08em}.tagline,small,.muted{color:#92a2bb;font-size:12px}.tagline{margin-top:4px}.eyebrow{color:#68e0c4;font-size:11px;letter-spacing:.12em}h1{font-size:30px;letter-spacing:-.04em}p{line-height:1.6}nav{display:flex;align-items:center;gap:16px;flex-wrap:wrap;margin:20px 0}a{color:#68e0c4;text-decoration:none}a:focus-visible,button:focus-visible{outline:2px solid #b7a1ff;outline-offset:3px}section,form:not(.inline),.card{background:#151e2de6;border:1px solid #27344a;border-radius:16px;padding:20px;margin:16px 0}.status{background:#101927;border-radius:10px;padding:12px;color:#92a2bb;font-size:13px}.status:before{content:'●';color:#68e0c4;margin-right:8px}.card{display:block;color:#eaf0fa}.card.fresh{background:#142c2b;border-color:#315b50}.card p{margin:10px 0}.meta{display:flex;align-items:center;justify-content:space-between;gap:8px}.badge{background:#19372f;color:#68e0c4;border-radius:8px;padding:5px 10px;font-size:11px;white-space:nowrap}.badge.public{background:#29223f;color:#b7a1ff}.preview{overflow:hidden;text-overflow:ellipsis;white-space:nowrap}.key{overflow-wrap:anywhere;font-size:14px}.message{white-space:pre-wrap;overflow-wrap:anywhere}label{display:block;font-size:13px;font-weight:600}input,textarea,select,button,.button{width:100%;padding:13px;margin:8px 0 18px;border:1px solid #34445b;border-radius:10px;background:#0f1826;color:#eaf0fa;font:inherit}textarea{resize:vertical}input:focus,textarea:focus,select:focus{outline:2px solid #68e0c4;outline-offset:2px}button,.button{display:block;text-align:center;background:#68e0c4;color:#0c111b;border:0;font-weight:700;cursor:pointer;margin:18px 0 0}.secondary{background:#202d40;color:#eaf0fa}.inline{margin:0}.inline button{width:auto;padding:9px 14px;margin:0;background:#202d40;color:#eaf0fa}small{display:block;line-height:1.6}.error{color:#ff9caa}.empty{text-align:center;padding:30px}.empty svg{width:64px;height:64px}footer{margin-top:28px;border-top:1px solid #27344a;padding-top:16px}button:disabled{opacity:.4;cursor:default}
.contact-editor{margin:16px 0;color:#68e0c4}.contact-editor>summary,.contact-key>summary{cursor:pointer}.contact-table-wrap{overflow-x:auto;margin-top:16px;border:1px solid #27344a;border-radius:12px}.contact-table{width:100%;border-collapse:collapse;font-size:13px}.contact-table th,.contact-table td{padding:10px 12px;text-align:left;border-bottom:1px solid #27344a;vertical-align:middle}.contact-table th{color:#68e0c4;background:#19372f;font-size:11px;text-transform:uppercase;letter-spacing:.05em}.contact-table tbody tr:nth-child(odd){background:#151e2d}.contact-table tbody tr:nth-child(even){background:#111a28}.contact-table tbody tr:last-child td{border-bottom:0}.contact-table td:first-child{min-width:100px;max-width:200px;overflow-wrap:anywhere}.contact-key summary{white-space:nowrap;font:11px monospace;color:#92a2bb}.contact-key code{display:block;max-width:180px;margin-top:8px;overflow-wrap:anywhere;font-size:11px}.contact-actions{display:flex;gap:6px;flex-wrap:wrap;min-width:150px}.contact-actions .mini,.contact-actions .inline button{display:inline-block;width:auto;margin:0;padding:6px 8px;border-radius:6px;font-size:11px;font-weight:600;background:#202d40;color:#eaf0fa}.contact-actions .mini:first-child{color:#68e0c4}.contact-actions .inline .remove{background:#35202d;color:#ff9caa}.contact-table small{font-size:11px}
.message-nav{display:flex;align-items:center;justify-content:space-between;gap:12px;margin:16px 0}.message-nav button,.message-nav .button{width:36%;margin:0}.message-nav>span:not(.button){text-align:center;white-space:nowrap}.message-nav .disabled{opacity:.4;cursor:default}
.relay-table td{min-width:100px;max-width:260px;overflow-wrap:anywhere}.relay-table code{font-size:11px}.relay-table td:first-child{min-width:180px}.danger{background:#a92d43;color:#fff}
</style></head><body><main><div class="brand"><svg xmlns="http://www.w3.org/2000/svg" viewBox="0 0 64 64" role="img" aria-labelledby="title">
  <title id="title">Nostr Pager logo</title>
  <rect width="64" height="64" rx="18" fill="#19372f"/>
  <rect x="12" y="15" width="40" height="35" rx="8" fill="#0d191a" stroke="#68e0c4" stroke-width="2"/>
  <rect x="19" y="23" width="26" height="14" rx="3" fill="#68e0c4"/>
  <path d="M24 28h15m-15 4h9" stroke="#19372f" stroke-width="2" stroke-linecap="round"/>
  <path d="M19 43h9m6 0h9" stroke="#68e0c4" stroke-width="2" stroke-linecap="round"/>
  <path d="M43 9h8l5 5" fill="none" stroke="#b7a1ff" stroke-width="3" stroke-linecap="round" stroke-linejoin="round"/>
</svg><div><div class="wordmark">NOSTR PAGER</div><div class="tagline">Your private signal.</div></div></div>
)WEB";
static const char webScript[] = R"WEB(// Matrix rain background (shares this file to save a request)
(() => {
  if (typeof matchMedia !== 'function' || matchMedia('(prefers-reduced-motion: reduce)').matches) return;
  const canvas = document.createElement('canvas');
  canvas.setAttribute('aria-hidden', 'true');
  canvas.style.cssText = 'position:fixed;left:0;top:0;width:100%;height:100%;z-index:-1;pointer-events:none;opacity:.6';
  document.body.prepend(canvas);
  const ctx = canvas.getContext('2d');
  const glyphs = Array.from('ｱｲｳｴｵｶｷｸｹｺｻｼｽｾｿﾀﾁﾂﾃﾄﾅﾆﾇﾈﾉﾊﾋﾌﾍﾎﾏﾐﾑﾒﾓﾔﾕﾖﾗﾘﾙﾚﾛﾜﾝ0123456789:.=*+-<>|ｦ');
  const pick = () => glyphs[(Math.random() * glyphs.length) | 0];
  // Three depth layers: small/slow/dim at the back, large/fast/bright in front.
  const layers = [
    {size: 12, speed: [5, 11], alpha: .38, glow: 0},
    {size: 17, speed: [9, 18], alpha: .65, glow: 0},
    {size: 24, speed: [14, 28], alpha: 1, glow: 10}
  ];
  let width = 0, height = 0, dpr = 1, columns = [];
  const reset = (c, initial) => {
    const l = c.layer;
    c.rows = Math.ceil(height / l.size) + 2;
    c.length = 8 + ((Math.random() * 22) | 0);
    c.speed = l.speed[0] + Math.random() * (l.speed[1] - l.speed[0]);
    c.y = initial ? -Math.random() * (c.rows + c.length) : -((Math.random() * 24) | 0);
    c.cells = Array.from({length: c.rows}, pick);
  };
  const build = () => {
    dpr = Math.min(window.devicePixelRatio || 1, 2);
    width = innerWidth; height = innerHeight;
    canvas.width = Math.round(width * dpr); canvas.height = Math.round(height * dpr);
    columns = [];
    layers.forEach((layer, index) => {
      const step = layer.size * .92, count = Math.ceil(width / step);
      const density = [.55, .6, .45][index];
      for (let i = 0; i < count; i++) {
        if (Math.random() > density) continue;
        const c = {layer, x: i * step + (Math.random() - .5) * 2};
        reset(c, true); columns.push(c);
      }
    });
  };
  let last = 0;
  const frame = now => {
    requestAnimationFrame(frame);
    if (now - last < 33) return; // ~30 fps keeps the pager's page light on phones
    const dt = Math.min((now - last) / 1000, .1); last = now;
    // Mirrored, like the film's reversed katakana.
    ctx.setTransform(-dpr, 0, 0, dpr, width * dpr, 0);
    ctx.clearRect(0, 0, width, height);
    ctx.textAlign = 'center'; ctx.textBaseline = 'top';
    let font = '';
    for (const c of columns) {
      const l = c.layer;
      const before = Math.floor(c.y);
      c.y += c.speed * dt;
      const head = Math.floor(c.y);
      for (let r = before + 1; r <= head; r++) if (r >= 0 && r < c.rows) c.cells[r] = pick();
      if (Math.random() < .08) { // glyphs flicker as the stream falls
        const r = head - ((Math.random() * c.length) | 0);
        if (r >= 0 && r < c.rows) c.cells[r] = pick();
      }
      if (head - c.length > c.rows) { reset(c, false); continue; }
      const f = l.size + 'px "MS Gothic","Noto Sans Mono CJK JP",monospace';
      if (f !== font) { ctx.font = f; font = f; }
      for (let k = 0; k < c.length; k++) {
        const r = head - k;
        if (r < 0 || r >= c.rows) continue;
        const fade = Math.pow(1 - k / c.length, 1.6);
        if (k === 0) {
          ctx.shadowColor = '#7dffa8'; ctx.shadowBlur = l.glow;
          ctx.fillStyle = 'rgba(225,255,235,' + l.alpha + ')';
        } else {
          ctx.shadowBlur = 0;
          ctx.fillStyle = k === 1 ? 'rgba(150,255,175,' + l.alpha * .9 + ')' : 'rgba(0,' + (150 + 105 * fade | 0) + ',70,' + (fade * l.alpha).toFixed(3) + ')';
        }
        ctx.fillText(c.cells[r], c.x + l.size / 2, r * l.size);
      }
    }
    ctx.shadowBlur = 0;
  };
  let timer;
  addEventListener('resize', () => { clearTimeout(timer); timer = setTimeout(build, 200); });
  build();
  requestAnimationFrame(frame);
})();
const $ = id => document.getElementById(id);
const text = $('text');
const contactChoice = $('contactChoice'), recipient = $('recipient');
if (contactChoice && recipient) {
  contactChoice.addEventListener('change', () => { recipient.value = contactChoice.value; });
  recipient.addEventListener('input', () => { contactChoice.value = ''; });
}
if (text) text.addEventListener('input', () => {
  const bytes = new TextEncoder().encode(text.value).length;
  $('count').textContent = `${bytes} / 512 bytes`;
  text.setCustomValidity(bytes > 512 ? 'Use at most 512 UTF-8 bytes.' : '');
});
function element(tag, value, cls) {
  const el = document.createElement(tag);
  if (value !== undefined) el.textContent = value;
  if (cls) el.className = cls;
  return el;
}
let inboxMessages = [], cursor = 0;
let renderedCard;
let anchor = new URLSearchParams(location.search).get('anchor') || '';
function renderInbox() {
  inboxMessages = inboxMessages.filter(m => !m.expiresAt || Date.now() / 1000 < m.expiresAt);
  const anchored = inboxMessages.findIndex(m => m.id === anchor);
  cursor = anchored >= 0 ? anchored : Math.min(cursor, Math.max(0, inboxMessages.length - 1));
  const m = inboxMessages[cursor];
  anchor = m ? m.id : '';
  $('previous').disabled = !m || cursor === 0;
  $('next').disabled = !m || cursor + 1 >= inboxMessages.length;
  $('position').textContent = `${m ? cursor + 1 : 0} / ${inboxMessages.length}`;
  $('unread').textContent = `${inboxMessages.filter(m => !m.read && !m.outgoing).length} unread`;
  const cardState = JSON.stringify(m || null);
  if (cardState === renderedCard) return;
  renderedCard = cardState;
  if (!m) {
    $('messages').replaceChildren(element('section', 'Your quiet corner. Waiting for a message.', 'empty'));
    return;
  }
  const card = element('a', undefined, `card${!m.read && !m.outgoing ? ' fresh' : ''}`);
  card.href = '/message?id=' + encodeURIComponent(m.id);
  const meta = element('div', undefined, 'meta');
  meta.append(element('span', `${m.outgoing ? '↑ To' : '✉ From'} ${m.peerName || m.peer.slice(0,10)}`), element('span', m.kind !== 1 ? 'DM' : 'NOTE', `badge${m.kind !== 1 ? '' : ' public'}`));
  card.append(meta, element('p', m.text, 'preview'), element('small', `${new Date(m.timestamp * 1000).toLocaleString()}${m.outgoing ? ' · ' + m.delivery : !m.read ? ' · New message' : ''}`));
  $('messages').replaceChildren(card);
}
if ($('previous')) $('previous').addEventListener('click', () => {
  if (cursor === 0 || !inboxMessages.length) return;
  anchor = inboxMessages[--cursor].id; renderInbox();
});
if ($('next')) $('next').addEventListener('click', () => {
  if (cursor + 1 >= inboxMessages.length) return;
  anchor = inboxMessages[++cursor].id; renderInbox();
});
let refreshPending = null, stateTag = '', lastState = null;
function refresh() {
  if ((!$('messages') && !$('connection-required')) || document.hidden) return Promise.resolve();
  if (refreshPending) return refreshPending;
  refreshPending = fetchState().finally(() => { refreshPending = null; });
  return refreshPending;
}
async function fetchState() {
  const controller = new AbortController();
  const timeout = setTimeout(() => controller.abort(), 10000);
  try {
    const response = await fetch('/api/state', {cache:'no-store', signal:controller.signal, headers: stateTag && lastState ? {'If-None-Match': stateTag} : {}});
    if (response.status === 401) { location.replace('/login'); return; }
    let state;
    if (response.status === 304 && lastState) state = lastState; // unchanged: nothing was sent again
    else {
      if (!response.ok) throw new Error('Device busy');
      state = await response.json();
      lastState = state; stateTag = response.headers?.get?.('ETag') || '';
    }
    const offline = state.wifiConnected === false || state.configured === false;
    const prompt = $('connection-required'), content = $('connected-content');
    if (prompt) {
      prompt.hidden = !offline;
      if (content) content.hidden = offline;
      else if (!offline) { location.replace('/messages'); return; }
      if ($('connection-hint')) $('connection-hint').textContent = state.wifiConnected === false
        ? 'Connect the pager to Wi-Fi. Open configuration to choose a network and check your identity.'
        : 'Configure your Nostr identity to start using messages.';
    }
    if (offline) {
      inboxMessages = []; renderedCard = undefined;
      if ($('messages')) $('messages').replaceChildren();
      return;
    }
    if (!$('messages')) return; // Preserve form fields while checking connectivity.
    const age = Number(response.headers?.get('X-Pager-Snapshot-Age-Ms') || 0);
    $('status').textContent = state.status + (age > 5000 ? ' · Showing cached data while messaging is busy.' : '');
    inboxMessages = state.messages;
    renderInbox();
  } catch (error) {
    if ($('status')) $('status').textContent = 'Connection interrupted. Retrying…';
    if ($('connection-required')) $('connection-required').hidden = false;
    if ($('connected-content')) $('connected-content').hidden = true;
    if ($('connection-hint')) $('connection-hint').textContent = 'Cannot reach the pager. Check its Wi-Fi connection or open Setup on the display.';
  }
  finally { clearTimeout(timeout); }
}
refresh();
setInterval(refresh, 5000);
setInterval(() => {
  if ($('messages') && !document.hidden && inboxMessages.some(m => m.expiresAt && Date.now() / 1000 >= m.expiresAt)) renderInbox();
}, 1000);
const expiry = $('messageExpiry');
if (expiry) {
  const checkExpiry = () => {
    if (Date.now() / 1000 >= Number(expiry.dataset.expires)) {
      $('messageContent').replaceChildren(element('p', 'Message expired.'));
      location.replace('/messages');
    }
  };
  checkExpiry();
  setInterval(checkExpiry, 1000);
}
document.addEventListener('visibilitychange', refresh);
)WEB";
